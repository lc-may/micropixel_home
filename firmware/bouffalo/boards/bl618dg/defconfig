## firmware/bouffalo/boards/bl618dg/defconfig
```kconfig
# SPDX-License-Identifier: Apache-2.0
ifneq ($(filter 1,$(AUDIO_TEST) $(HOST_PORT)),)
CONFIG_XCODEC_IO = y
endif
ifeq ($(HOST_PORT),1)
CONFIG_SHELL = y
CONFIG_BSP_LCD = y
CONFIG_LVGL9 = y
CONFIG_LVGL9_PORT_DISP = y
CONFIG_LVGL9_OSD_LAYER = n
CONFIG_LVGL9_PORT_INDEV = n
CONFIG_LVGL9_PORT_FS = n
CONFIG_TLSF = y
CONFIG_RF = y
CONFIG_XZ = y
CONFIG_OVERRIDE_PTFILE = "orion/config/partition_cfg_8M.toml"
CONFIG_GCC_COMPILE_LTO = y
CONFIG_BACKTRACE = n
CONFIG_BFLB_MTD = y
CONFIG_PARTITION = y
CONFIG_LITTLEFS = y
ifneq ($(filter wifi dual,$(RADIO)),)
CONFIG_POSIX = y
CONFIG_LWIP = y
CONFIG_WIFI6 = y
CONFIG_FHOST = y
CONFIG_DHCPD = y
CONFIG_HTTP = y
CONFIG_HTTP_CLIENT = y
CONFIG_MBEDTLS = y
CONFIG_MBEDTLS_V2 = y
CONFIG_X509_CERTIFICATE_BUNDLE = y
endif
ifneq ($(filter ble dual,$(RADIO)),)
CONFIG_BLUETOOTH = y
CONFIG_BT_CONN = 2
CONFIG_BLE_TX_BUFF_DATA = 4
CONFIG_EM_SIZE = 32
CONFIG_BT_SETTINGS = n
endif
ifeq ($(RADIO),ble)
CONFIG_BTBLECONTROLLER_LIB = ble1m2s1bredr0
endif
ifeq ($(RADIO),dual)
CONFIG_BTBLECONTROLLER_LIB = ble1m2s1bredr1
CONFIG_BT_BREDR = y
CONFIG_BT_A2DP = y
CONFIG_BT_A2DP_SINK = y
CONFIG_BT_A2DP_SOURCE = y
CONFIG_BT_AVRCP = y
CONFIG_COEX = y
CONFIG_BT_PATH = y
CONFIG_COEX_BOARD_TOPOLOGY_STANDALONE_SINGLE_ANT_SPDT = y
CONFIG_COEX_BOARD_SPDT_GPIO = 16
endif
endif

ifneq ($(strip $(DISPLAY_CONFIG)),)
include $(DISPLAY_CONFIG)
CONFIG_BSP_LCD = n
CONFIG_BSP_DISPLAY = y
CONFIG_DISPLAY_DEFAULT = y
CONFIG_LVGL9 = y
CONFIG_LVGL9_PORT_DISP = y
CONFIG_SYSINIT = y
endif

CONFIG_ROMAPI = n
CONFIG_SKIP_COMBINE = y
CONFIG_DUALCORE_DISABLE = y
CONFIG_FREERTOS = y
CONFIG_PSRAM = y
CONFIG_PSRAM_COPY_CODE = $(if $(filter 1,$(HOST_PORT)),y,n)
CONFIG_STDATOMIC = y
CONFIG_PSRAM_FOR_AP_SIZE = 0x1000000
CONFIG_PSRAM_LENGTH = 0x1000000
CONFIG_WRAM_FOR_AP_SIZE = 0x50000
```
